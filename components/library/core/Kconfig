## components/library/core/Kconfig
```kconfig
menu "Core Library Configuration"

    config HTTP_CLIENT_RESPONSE_BUFFER_SIZE
        int "HTTP client response buffer size (bytes)"
        default 4096
        range 512 32768
        help
            Size of the pre-allocated buffer for HTTP response data.
            This buffer is allocated once at HttpClient construction and
            reused for all requests. Larger buffers allow larger responses
            but consume more RAM.

endmenu
```

## sdkconfig.defaults
```kconfig
# =============================================================================
# Measurement Probe - ESP32-C3 SDK Configuration Defaults
# =============================================================================

# =============================================================================
# Flash Configuration
# =============================================================================
CONFIG_ESPTOOLPY_FLASHSIZE_4MB=y

# =============================================================================
# Task Stack Sizes
# =============================================================================
CONFIG_ESP_MAIN_TASK_STACK_SIZE=16384
CONFIG_ESP_SYSTEM_EVENT_TASK_STACK_SIZE=8192
CONFIG_ESP_TIMER_TASK_STACK_SIZE=8192

# =============================================================================
# Compiler Configuration
# =============================================================================
# Disable C++ exceptions and RTTI (embedded best practice, saves ~50KB)
CONFIG_COMPILER_CXX_EXCEPTIONS=n
CONFIG_COMPILER_CXX_RTTI=n

# Optimize for size (important for OTA with limited flash)
CONFIG_COMPILER_OPTIMIZATION_SIZE=y

# Stack smashing protection (security)
CONFIG_COMPILER_STACK_CHECK_MODE_STRONG=y

# =============================================================================
# Power Management (critical for battery operation)
# =============================================================================
CONFIG_PM_ENABLE=y
CONFIG_PM_DFS_INIT_AUTO=y
CONFIG_FREERTOS_USE_TICKLESS_IDLE=y

# =============================================================================
# WiFi Optimization
# =============================================================================
CONFIG_ESP_WIFI_STATIC_RX_BUFFER_NUM=4
CONFIG_ESP_WIFI_DYNAMIC_RX_BUFFER_NUM=16
CONFIG_ESP_WIFI_DYNAMIC_TX_BUFFER_NUM=16
CONFIG_ESP_WIFI_TX_BA_WIN=6
CONFIG_ESP_WIFI_RX_BA_WIN=6
CONFIG_ESP_WIFI_SLP_IRAM_OPT=y
CONFIG_ESP_WIFI_SLP_DEFAULT_MIN_ACTIVE_TIME=50
CONFIG_ESP_WIFI_SLP_DEFAULT_MAX_ACTIVE_TIME=10
CONFIG_ESP_WIFI_IRAM_OPT=y
CONFIG_ESP_WIFI_RX_IRAM_OPT=y

# =============================================================================
# TLS/HTTPS Configuration
# =============================================================================
# Google Cloud Run certificates need larger buffer (~6KB chain)
CONFIG_MBEDTLS_SSL_MAX_CONTENT_LEN=16384
CONFIG_MBEDTLS_ASYMMETRIC_CONTENT_LEN=y
CONFIG_MBEDTLS_SSL_IN_CONTENT_LEN=16384
CONFIG_MBEDTLS_SSL_OUT_CONTENT_LEN=4096

# =============================================================================
# LWIP Memory Optimization
# =============================================================================
CONFIG_LWIP_IRAM_OPTIMIZATION=y
CONFIG_LWIP_MAX_SOCKETS=4
CONFIG_LWIP_MAX_ACTIVE_TCP=4
CONFIG_LWIP_MAX_LISTENING_TCP=2

# =============================================================================
# Logging
# =============================================================================
CONFIG_LOG_MAXIMUM_LEVEL_VERBOSE=y
CONFIG_BOOTLOADER_LOG_LEVEL_WARN=y

# =============================================================================
# Boot & OTA
# =============================================================================
CONFIG_BOOTLOADER_SKIP_VALIDATE_IN_DEEP_SLEEP=y
CONFIG_BOOTLOADER_APP_ROLLBACK_ENABLE=y
CONFIG_PARTITION_TABLE_CUSTOM=y
CONFIG_PARTITION_TABLE_CUSTOM_FILENAME="partitions.csv"


# =============================================================================
# Sleep Workarounds
# =============================================================================
CONFIG_ESP_SLEEP_FLASH_LEAKAGE_WORKAROUND=y

# =============================================================================
# Disable Unused Features (flash/RAM savings)
# =============================================================================
CONFIG_VFS_SUPPORT_DIR=n
CONFIG_VFS_SUPPORT_SELECT=n
CONFIG_VFS_SUPPORT_TERMIOS=n

# =============================================================================
# Bluetooth (NimBLE for BLE provisioning)
# =============================================================================
CONFIG_BT_ENABLED=y
CONFIG_BT_NIMBLE_ENABLED=y

# Roles: Peripheral required for provisioning (device advertises and accepts connections)
CONFIG_BT_NIMBLE_ROLE_PERIPHERAL=y
CONFIG_BT_NIMBLE_ROLE_BROADCASTER=y
CONFIG_BT_NIMBLE_ROLE_CENTRAL=n
CONFIG_BT_NIMBLE_ROLE_OBSERVER=n

# Disable unused BLE 5.0 features
CONFIG_BT_NIMBLE_50_FEATURE_SUPPORT=n
CONFIG_BT_NIMBLE_EXT_ADV=n
CONFIG_BT_NIMBLE_MAX_CONNECTIONS=1

# =============================================================================
# WiFi Provisioning (BLE only - no SoftAP)
# =============================================================================
CONFIG_ESP_WIFI_SOFTAP_SUPPORT=n
CONFIG_WIFI_PROV_SCAN_MAX_ENTRIES=8
CONFIG_WIFI_PROV_AUTOSTOP_TIMEOUT=30

# =============================================================================
# NVS Encryption (for secure credential storage)
# =============================================================================
# CONFIG_NVS_ENCRYPTION=y
```
